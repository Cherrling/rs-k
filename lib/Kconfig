## lib/Kconfig
```kconfig
# SPDX-License-Identifier: GPL-2.0-only
#
# Library configuration
#

config BINARY_PRINTF
	def_bool n

menu "Library routines"

config LINEAR_RANGES
	tristate

config PACKING
	bool "Generic bitfield packing and unpacking"
	select BITREVERSE
	default n
	help
	  This option provides the packing() helper function, which permits
	  converting bitfields between a CPU-usable representation and a
	  memory representation that can have any combination of these quirks:
	    - Is little endian (bytes are reversed within a 32-bit group)
	    - The least-significant 32-bit word comes first (within a 64-bit
	      group)
	    - The most significant bit of a byte is at its right (bit 0 of a
	      register description is numerically 2^7).
	  Drivers may use these helpers to match the bit indices as described
	  in the data sheets of the peripherals they are in control of.

	  When in doubt, say N.

config PACKING_KUNIT_TEST
	tristate "KUnit tests for packing library" if !KUNIT_ALL_TESTS
	depends on PACKING && KUNIT
	default KUNIT_ALL_TESTS
	help
	  This builds KUnit tests for the packing library.

	  For more information on KUnit and unit tests in general,
	  please refer to the KUnit documentation in Documentation/dev-tools/kunit/.

	  When in doubt, say N.

config BITREVERSE
	tristate
	select GENERIC_BITREVERSE if !HAVE_ARCH_BITREVERSE

config HAVE_ARCH_BITREVERSE
	bool
	default n
	depends on BITREVERSE
	help
	  This option enables the use of hardware bit-reversal instructions on
	  architectures which support such operations.

config GENERIC_BITREVERSE
	tristate
	depends on BITREVERSE
	help
	  Generic bit reversal implementation. Drivers should never enable
	  it explicitly. Instead, enable BITREVERSE.

	  Architectures may want to select it as a fall-back option for
	  HAVE_ARCH_BITREVERSE, when the hardware-accelerated bit reverse
	  instruction set is optional, like RISC-V ZBKB extension.

config ARCH_HAS_STRNCPY_FROM_USER
	bool

config ARCH_HAS_STRNLEN_USER
	bool

config GENERIC_STRNCPY_FROM_USER
	def_bool !ARCH_HAS_STRNCPY_FROM_USER

config GENERIC_STRNLEN_USER
	def_bool !ARCH_HAS_STRNLEN_USER

config GENERIC_NET_UTILS
	bool

source "lib/math/Kconfig"

config NO_GENERIC_PCI_IOPORT_MAP
	bool

config GENERIC_IOMAP
	bool
	select GENERIC_PCI_IOMAP

config STMP_DEVICE
	bool

config ARCH_USE_CMPXCHG_LOCKREF
	bool

config ARCH_HAS_FAST_MULTIPLIER
	bool

config ARCH_USE_SYM_ANNOTATIONS
	bool

config INDIRECT_PIO
	bool "Access I/O in non-MMIO mode"
	depends on ARM64
	depends on HAS_IOPORT
	help
	  On some platforms where no separate I/O space exists, there are I/O
	  hosts which can not be accessed in MMIO mode. Using the logical PIO
	  mechanism, the host-local I/O resource can be mapped into system
	  logic PIO space shared with MMIO hosts, such as PCI/PCIe, then the
	  system can access the I/O devices with the mapped-logic PIO through
	  I/O accessors.

	  This way has relatively little I/O performance cost. Please make
	  sure your devices really need this configure item enabled.

	  When in doubt, say N.

config INDIRECT_IOMEM
	bool
	help
	  This is selected by other options/architectures to provide the
	  emulated iomem accessors.

config INDIRECT_IOMEM_FALLBACK
	bool
	depends on INDIRECT_IOMEM
	help
	  If INDIRECT_IOMEM is selected, this enables falling back to plain
	  mmio accesses when the IO memory address is not a registered
	  emulated region.

config TRACE_MMIO_ACCESS
	bool "Register read/write tracing"
	depends on TRACING && ARCH_HAVE_TRACE_MMIO_ACCESS
	help
	  Create tracepoints for MMIO read/write operations. These trace events
	  can be used for logging all MMIO read/write operations.

source "lib/crc/Kconfig"
source "lib/crypto/Kconfig"
source "lib/raid/Kconfig"

config XXHASH
	tristate

config AUDIT_GENERIC
	bool
	depends on AUDIT && !AUDIT_ARCH
	default y

config AUDIT_ARCH_COMPAT_GENERIC
	bool
	default n

config AUDIT_COMPAT_GENERIC
	bool
	depends on AUDIT_GENERIC && AUDIT_ARCH_COMPAT_GENERIC && COMPAT
	default y

#
# compression support is select'ed if needed
#
config 842_COMPRESS
	select CRC32
	tristate

config 842_DECOMPRESS
	select CRC32
	tristate

config ZLIB_INFLATE
	tristate

config ZLIB_DEFLATE
	tristate
	select BITREVERSE

config ZLIB_DFLTCC
	def_bool y
	depends on S390
	prompt "Enable s390x DEFLATE CONVERSION CALL support for kernel zlib"
	help
	 Enable s390x hardware support for zlib in the kernel.

config LZO_COMPRESS
	tristate

config LZO_DECOMPRESS
	tristate

config LZ4_COMPRESS
	tristate

config LZ4HC_COMPRESS
	tristate

config LZ4_DECOMPRESS
	tristate

config ZSTD_COMMON
	select XXHASH
	tristate

config ZSTD_COMPRESS
	select ZSTD_COMMON
	tristate

config ZSTD_DECOMPRESS
	select ZSTD_COMMON
	tristate

source "lib/xz/Kconfig"

#
# These all provide a common interface (hence the apparent duplication with
# ZLIB_INFLATE; DECOMPRESS_GZIP is just a wrapper.)
#
config DECOMPRESS_GZIP
	select ZLIB_INFLATE
	tristate

config DECOMPRESS_BZIP2
	tristate

config DECOMPRESS_LZMA
	tristate

config DECOMPRESS_XZ
	select XZ_DEC
	tristate

config DECOMPRESS_LZO
	select LZO_DECOMPRESS
	tristate

config DECOMPRESS_LZ4
	select LZ4_DECOMPRESS
	tristate

config DECOMPRESS_ZSTD
	select ZSTD_DECOMPRESS
	tristate

#
# Generic allocator support is selected if needed
#
config GENERIC_ALLOCATOR
	bool

#
# reed solomon support is select'ed if needed
#
config REED_SOLOMON
	tristate
	
config REED_SOLOMON_ENC8
	bool

config REED_SOLOMON_DEC8
	bool

config REED_SOLOMON_ENC16
	bool

config REED_SOLOMON_DEC16
	bool

#
# BCH support is selected if needed
#
config BCH
	tristate
	select BITREVERSE

config BCH_CONST_PARAMS
	bool
	help
	  Drivers may select this option to force specific constant
	  values for parameters 'm' (Galois field order) and 't'
	  (error correction capability). Those specific values must
	  be set by declaring default values for symbols BCH_CONST_M
	  and BCH_CONST_T.
	  Doing so will enable extra compiler optimizations,
	  improving encoding and decoding performance up to 2x for
	  usual (m,t) values (typically such that m*t < 200).
	  When this option is selected, the BCH library supports
	  only a single (m,t) configuration. This is mainly useful
	  for NAND flash board drivers requiring known, fixed BCH
	  parameters.

config BCH_CONST_M
	int
	range 5 15
	help
	  Constant value for Galois field order 'm'. If 'k' is the
	  number of data bits to protect, 'm' should be chosen such
	  that (k + m*t) <= 2**m - 1.
	  Drivers should declare a default value for this symbol if
	  they select option BCH_CONST_PARAMS.

config BCH_CONST_T
	int
	help
	  Constant value for error correction capability in bits 't'.
	  Drivers should declare a default value for this symbol if
	  they select option BCH_CONST_PARAMS.

#
# Textsearch support is select'ed if needed
#
config TEXTSEARCH
	bool

config TEXTSEARCH_KMP
	tristate

config TEXTSEARCH_BM
	tristate

config TEXTSEARCH_FSM
	tristate

config BTREE
	bool

config RUST_LIST_SORT
	bool "Rust implementation of list_sort()"
	depends on RUST
	default y
	help
	  Use Rust for the production implementation of list_sort().
	  The exported C entry point remains as an ABI adapter.

	  This is part of the experimental native Rust kernel migration.
	  If unsure, say Y.

config RUST_MAPLE_TREE_LOAD
	bool "Rust implementation of Maple Tree loads"
	depends on RUST && X86_64
	default y
	help
	  Use Rust for the production index lookup, root handling, node
	  descent, dead-node restart, and RCU lifecycle behind mtree_load().

	  Maple node encoding, node layout, protected slot access, tracepoint
	  emission, and lockdep checks remain in C. The exported C entry point
	  remains as an ABI adapter. The C fallback retains the complete load
	  traversal.

	  This is part of the experimental native Rust kernel migration.
	  If unsure, say Y.

config RUST_PERCPU_REFCOUNT
	bool "Rust implementation of percpu_ref() lifecycle"
	depends on RUST
	default y
	help
	  Use Rust for the production lifecycle state machine of percpu_ref().
	  This includes initialization, mode switching, kill confirmation, exit,
	  reinitialization, and resurrection.

	  The per-CPU get/put fast paths remain inline C because they depend on
	  architecture-specific atomic and per-CPU primitives.

	  This is part of the experimental native Rust kernel migration.
	  If unsure, say Y.

config RUST_REFCOUNT
	bool "Rust implementation of refcount_t saturation"
	depends on RUST
	default y
	help
	  Use Rust for the production refcount_t increment, decrement,
	  saturation, limited-acquire, and conditional-locking state machine.

	  Architecture atomics, memory barriers, and kernel locking primitives
	  remain in C because they depend on the architecture and scheduler.

	  This is part of the experimental native Rust kernel migration.
	  If unsure, say Y.

config RUST_RBTREE
	bool "Rust implementation of red-black tree operations"
	depends on RUST
	default y
	help
	  Use Rust for the core red-black tree operations in lib/rbtree.c.
	  The existing C entry points remain as ABI adapters, but the tree
	  algorithms execute in Rust.

	  This is part of the experimental native Rust kernel migration.
	  If unsure, say Y.

config RUST_TIMERQUEUE
	bool "Rust implementation of timer queues"
	depends on RUST
	default y
	help
	  Use Rust for the production timer queue insertion, deletion,
	  successor traversal, and linked-tree insertion operations.

	  Locking and timer callback semantics remain with the existing
	  callers. The exported C entry points remain as ABI adapters.

	  This is part of the experimental native Rust kernel migration.
	  If unsure, say Y.

config RUST_FIND_BIT
	bool "Rust implementation of generic bit searches"
	depends on RUST && X86_64
	default y
	help
	  Use Rust for the production implementation of the generic
	  find_first_bit(), find_next_bit(), find_nth_bit(),
	  find_last_bit(), and related bitmap searches.

	  The exported C entry points remain as ABI adapters. This option
	  currently supports x86_64, where the generic C searches are used.

	  This is part of the experimental native Rust kernel migration.
	  If unsure, say Y.

config RUST_BITMAP_OPS
	bool "Rust implementation of generic bitmap operations"
	depends on RUST && X86_64 && RUST_FIND_BIT
	default y
	help
	  Use Rust for the production implementation of the generic bitmap
	  operations in lib/bitmap.c, including logical operations, shifts,
	  range updates, population counts, mappings, and array conversions.

	  The exported C entry points remain as ABI adapters. Bitmap allocation,
	  text parsing, and sequence-file formatting remain in C.

	  This is part of the experimental native Rust kernel migration.
	  If unsure, say Y.

config RUST_KFIFO
	bool "Rust implementation of generic kernel FIFOs"
	depends on RUST && X86_64
	default y
	help
	  Use Rust for the production ring-buffer algorithms in lib/kfifo.c,
	  including wrap-around, record framing, user-copy orchestration,
	  scatterlist preparation, and index advancement.

	  Allocation, low-level user access, memory barriers, and scatterlist
	  mutation remain in C. The exported entry points remain as ABI
	  adapters.

	  This is part of the experimental native Rust kernel migration.
	  If unsure, say Y.

config RUST_GENRADIX
	bool "Rust implementation of generic radix trees"
	depends on RUST && X86_64
	default y
	help
	  Use Rust for the production generic-radix-tree traversal, growth,
	  iteration, preallocation, and recursive release algorithms.

	  Node allocation, atomic root and child publication, root exchange,
	  and the node representation remain in C. The exported entry points
	  remain as ABI adapters.

	  This is part of the experimental native Rust kernel migration.
	  If unsure, say Y.

config RUST_XARRAY_LOAD
	bool "Rust implementation of XArray load traversal"
	depends on RUST && X86_64
	default y
	help
	  Use Rust for the production XArray root selection, node descent,
	  sibling expansion, and RCU retry loop behind xa_load() and xas_load().

	  RCU primitives, tagged entry encoding, node layout, and slot loads
	  remain in C. The exported entry points remain as ABI adapters.

	  This is part of the experimental native Rust kernel migration.
	  If unsure, say Y.

config RUST_XARRAY_NOMEM
	bool "Rust implementation of XArray allocation lifecycle"
	depends on RUST && X86_64
	default y
	help
	  Use Rust for the production XArray operation-preallocation lifecycle
	  behind xas_nomem() and xas_destroy().

	  Rust owns ENOMEM detection, pending-node chain cleanup, cursor
	  restart, and the decision to retain or release a new preallocation.
	  Slab allocation, node layout, RCU parent access, debug invariant
	  checks, and node reclamation remain in C. The exported entry points
	  remain as ABI adapters. The C fallback retains its existing
	  allocation-lifecycle policy.

	  This is part of the experimental native Rust kernel migration.
	  If unsure, say Y.

config RUST_XARRAY_FIND
	bool "Rust implementation of XArray forward search"
	depends on RUST_XARRAY_LOAD && X86_64
	default y
	help
	  Use Rust for the production XArray algorithm behind xas_find().
	  Rust owns cursor advancement, empty-subtree jumps, parent traversal,
	  index and offset updates, and maximum-index boundaries.

	  RCU and slot access primitives, node and cursor layouts, parent lookup,
	  and error classification remain in C. The exported xas_find() entry
	  point remains as an ABI adapter. The C fallback retains its existing
	  forward-search policy.

	  This is part of the experimental native Rust kernel migration.
	  If unsure, say Y.

config RUST_XARRAY_FIND_CONFLICT
	bool "Rust implementation of XArray range conflict search"
	depends on RUST_XARRAY_LOAD && X86_64
	default y
	help
	  Use Rust for the production algorithm behind xas_find_conflict().
	  Rust owns root start, child descent, range-boundary checks, sibling
	  skipping, locked slot access, and parent retreat.

	  XArray node and state layouts and tagged pointer primitives remain
	  in C. The exported xas_find_conflict() entry point remains as an ABI
	  adapter. The C fallback retains its existing conflict-search policy.

	  This is part of the experimental native Rust kernel migration.
	  If unsure, say Y.

config RUST_XARRAY_NEXT_PREV
	bool "Rust implementation of XArray adjacent cursor movement"
	depends on RUST_XARRAY_LOAD && X86_64
	default y
	help
	  Use Rust for the production algorithms behind xas_prev() and
	  xas_next(). Rust owns index wrapping, offset adjustment, parent
	  retreat, child descent, and restart and error dispatch.

	  Cursor and tagged-entry layouts, RCU slot and parent access, frozen
	  and node classification, and cursor loads remain in C. The exported
	  __xas_prev() and __xas_next() entry points remain as ABI adapters.
	  The C fallback retains its existing adjacent-index policy.

	  This is part of the experimental native Rust kernel migration.
	  If unsure, say Y.

config RUST_XARRAY_PAUSE
	bool "Rust implementation of XArray pause and cursor recovery"
	depends on RUST_XARRAY_LOAD && X86_64
	default y
	help
	  Use Rust for the production algorithm behind xas_pause(). Rust owns
	  cursor restart, sibling-run scanning, index advancement, and bounds
	  selection.

	  XArray node, state, sibling, and tagged-entry layouts and RCU slot
	  access remain in C. The exported xas_pause() entry point remains as
	  an ABI adapter. The C fallback retains its existing pause policy.

	  This is part of the experimental native Rust kernel migration.
	  If unsure, say Y.

config RUST_XARRAY_FIND_MARKED
	bool "Rust implementation of XArray marked forward search"
	depends on RUST_XARRAY_FIND && RUST_XARRAY_MARKS && X86_64
	default y
	help
	  Use Rust for the production XArray algorithm behind
	  xas_find_marked(). Rust owns cursor traversal, mark-driven chunk
	  jumps, sibling normalization, empty-subtree retreat, index updates,
	  and terminal cursor states.

	  Mark bitmaps, node and cursor layouts, root mark storage, slot and
	  parent access, and tagged encodings remain in C. The exported
	  xas_find_marked() entry point remains as an ABI adapter. The C
	  fallback retains its existing marked-search policy.

	  This is part of the experimental native Rust kernel migration.
	  If unsure, say Y.

config RUST_XARRAY_STORE
	bool "Rust implementation of XArray store mutation"
	depends on RUST_XARRAY_LOAD && X86_64
	default y
	help
	  Use Rust for the production XArray slot replacement, sibling update,
	  and node accounting loop behind xas_store().

	  Slot creation, node allocation and release, mark storage, RCU slot
	  publication, and the node layout remain in C. The exported xas_store()
	  entry point remains as an ABI adapter.

	  This is part of the experimental native Rust kernel migration.
	  If unsure, say Y.

config RUST_XARRAY_EXPAND
	bool "Rust implementation of XArray root expansion"
	depends on RUST_XARRAY_STORE && X86_64
	default y
	help
	  Use Rust for the production XArray algorithm that grows the root
	  until it can contain the requested index. Rust owns height selection,
	  node-chain growth, mark propagation, parent links, and publication
	  order.

	  Slab allocation, node initialization, mark storage, root publication,
	  update callbacks, and the node layout remain in C. The C fallback
	  retains its existing expansion policy.

	  This is part of the experimental native Rust kernel migration.
	  If unsure, say Y.

config RUST_XARRAY_CREATE
	bool "Rust implementation of XArray node-chain creation"
	depends on RUST_XARRAY_EXPAND && X86_64
	default y
	help
	  Use Rust for the production XArray algorithm that expands the root,
	  creates missing nodes, descends existing nodes, resolves sibling
	  entries, and positions the cursor at the selected slot.

	  Slab allocation, node initialization, RCU publication, mark storage,
	  update callbacks, and the node layout remain in C. The C fallback
	  retains its existing node-chain creation and cursor positioning policy.

	  This is part of the experimental native Rust kernel migration.
	  If unsure, say Y.

config RUST_XARRAY_CREATE_RANGE
	bool "Rust implementation of XArray range creation"
	depends on RUST_XARRAY_CREATE && X86_64
	default y
	help
	  Use Rust for the production XArray algorithm that prepares every
	  single-index slot covered by a multi-index range. Rust owns range
	  boundary calculation, backward chunk traversal, ancestor cursor
	  repositioning, and error-state restoration.

	  Node and state layouts, parent lookup, error classification, node
	  creation, and the public ABI remain in C. The C fallback retains its
	  existing range creation and cursor recovery policy.

	  This is part of the experimental native Rust kernel migration.
	  If unsure, say Y.

config RUST_XARRAY_RANGE_STORE
	bool "Rust implementation of XArray range stores and order queries"
	depends on XARRAY_MULTI && RUST_XARRAY_CREATE && \
		RUST_XARRAY_NOMEM && RUST_XARRAY_STORE && X86_64
	default y
	help
	  Use Rust for the production range decomposition, multi-index store
	  retries, and order queries behind xa_store_range(), xas_get_order(),
	  and xa_get_order().

	  Rust owns natural range selection, order calculation, operation
	  retries, sibling-run order discovery, and the complete store
	  control flow. XArray locking, RCU protection, tagged-entry encoding,
	  protected slot access, node layout, and node creation and publication
	  remain in C. The exported entry points remain as ABI adapters. The C
	  fallback retains the complete range-store and order-query policies.

	  This is part of the experimental native Rust kernel migration.
	  If unsure, say Y.

config RUST_XARRAY_FREE_NODES
	bool "Rust implementation of XArray node reclamation"
	depends on RUST_XARRAY_STORE && X86_64
	default y
	help
	  Use Rust for the production XArray algorithm that removes a subtree
	  from the tree and publishes retry markers for concurrent readers.

	  Node layout, parent lookup, update callbacks, and RCU reclamation
	  remain in C.

	  This is part of the experimental native Rust kernel migration.
	  If unsure, say Y.

config RUST_XARRAY_DELETE_NODE
	bool "Rust implementation of XArray node deletion and root shrinking"
	depends on RUST_XARRAY_FREE_NODES && X86_64
	default y
	help
	  Use Rust for the production XArray algorithm that removes empty
	  nodes, propagates parent accounting, clears an empty root, and
	  shrinks a root node that has only one child.

	  Node layout, parent lookup, root and slot publication, mark storage,
	  update callbacks, and RCU reclamation remain in C. The C fallback
	  retains its existing deletion and shrinking policy.

	  This is part of the experimental native Rust kernel migration.
	  If unsure, say Y.

config RUST_XARRAY_MARKS
	bool "Rust implementation of XArray mark lifecycle"
	depends on RUST_XARRAY_STORE && X86_64
	default y
	help
	  Use Rust for the production XArray mark lookup, ancestor
	  propagation, clearing, and initialization algorithms behind the
	  xas_*_mark() interfaces.

	  Mark bitmaps, root flag storage, parent traversal, locked roots, and
	  the node layout remain in C. The exported entry points remain as ABI
	  adapters.

	  This is part of the experimental native Rust kernel migration.
	  If unsure, say Y.

config RUST_XARRAY_DESTROY
	bool "Rust implementation of XArray teardown"
	depends on RUST_XARRAY_FREE_NODES && RUST_XARRAY_MARKS && X86_64
	default y
	help
	  Use Rust for the production XArray teardown policy behind xa_destroy().
	  Rust owns root detachment ordering, mark reinitialization, the
	  zero-busy empty-array case, subtree reclamation control, and reuse
	  semantics.

	  Interrupt-safe locking, root publication, flag storage, node layout,
	  RCU reclamation, and locked state construction remain in C. The
	  exported entry point remains as an ABI adapter. The C fallback retains
	  the complete teardown policy.

	  This is part of the experimental native Rust kernel migration.
	  If unsure, say Y.

config RUST_XARRAY_ALLOC
	bool "Rust implementation of XArray ID allocation"
	depends on RUST_XARRAY_CREATE && RUST_XARRAY_FIND_MARKED && \
		RUST_XARRAY_MARKS && RUST_XARRAY_NOMEM && \
		RUST_XARRAY_STORE && X86_64
	default y
	help
	  Use Rust for the production implementation behind __xa_alloc() and
	  __xa_alloc_cyclic(). Rust owns free-mark search, first-fit selection,
	  range exhaustion, allocation retries, next-ID updates, and cyclic
	  wrap reporting.

	  XArray locking, operation preallocation, free-mark storage, node
	  layout, and tagged-entry encoding remain in C. The exported entry
	  points remain as ABI adapters. The C fallback retains the complete
	  allocation policy.

	  This is part of the experimental native Rust kernel migration.
	  If unsure, say Y.

config RUST_XARRAY_SQUASH_MARKS
	bool "Rust implementation of XArray multi-index mark squashing"
	depends on RUST_XARRAY_MARKS && X86_64
	default y
	help
	  Use Rust for the production XArray algorithm that combines marks
	  from a multi-index sibling range onto its first slot.

	  Mark bitmap access remains in C. The C adapter remains available when
	  the Rust squash implementation is disabled.

	  This is part of the experimental native Rust kernel migration.
	  If unsure, say Y.

config RUST_XARRAY_SPLIT
	bool "Rust implementation of XArray multi-index splitting"
	depends on RUST_XARRAY_LOAD && RUST_XARRAY_NOMEM && \
		RUST_XARRAY_STORE && RUST_XARRAY_MARKS && X86_64
	default y
	help
	  Use Rust for the production XArray two-phase multi-index split
	  lifecycle behind xas_split_alloc() and xas_split().

	  Rust owns order validation, split-node preparation, pending-chain
	  growth, child and sibling publication, mark propagation, and value
	  accounting. Slab allocation, node and entry layout, RCU publication,
	  mark bitmaps, update callbacks, and error encoding remain in C. The
	  exported entry points remain as ABI adapters. The C fallback retains
	  the complete split allocation and commit algorithms.

	  This is part of the experimental native Rust kernel migration.
	  If unsure, say Y.

config RUST_XARRAY_TRY_SPLIT
	bool "Rust implementation of XArray one-shot multi-index splitting"
	depends on RUST_XARRAY_SPLIT && X86_64
	default y
	help
	  Use Rust for the production one-shot XArray multi-index split
	  policy behind xas_try_split_min_order() and xas_try_split().

	  Rust owns the one-level split validation, opportunistic GFP_NOWAIT
	  allocation, prepared-node consumption, mark propagation, and value
	  accounting. Slab allocation, node and entry layout, RCU publication,
	  mark bitmaps, update callbacks, and error encoding remain in C. The
	  exported entry points remain as ABI adapters. The C fallback retains
	  the complete one-shot split policy.

	  This is part of the experimental native Rust kernel migration.
	  If unsure, say Y.

config RBTREE_RUST_KUNIT_TEST
	bool "KUnit tests for the Rust rbtree implementation"
	depends on RUST_RBTREE && KUNIT
	default KUNIT_ALL_TESTS
	help
	  This option enables KUnit tests for the C ABI adapters and the
	  Rust implementation of the core red-black tree operations.

	  These tests are only for development and testing, not for regular
	  kernel use cases.

	  If unsure, say N.

config INTERVAL_TREE
	bool
	help
	  Simple, embeddable, interval-tree. Can find the start of an
	  overlapping range in log(n) time and then iterate over all
	  overlapping nodes. The algorithm is implemented as an
	  augmented rbtree.

	  See:

		Documentation/core-api/rbtree.rst

	  for more information.

config INTERVAL_TREE_SPAN_ITER
	bool
	depends on INTERVAL_TREE

config XARRAY_MULTI
	bool
	help
	  Support entries which occupy multiple consecutive indices in the
	  XArray.

config ASSOCIATIVE_ARRAY
	bool
	help
	  Generic associative array.  Can be searched and iterated over whilst
	  it is being modified.  It is also reasonably quick to search and
	  modify.  The algorithms are non-recursive, and the trees are highly
	  capacious.

	  See:

		Documentation/core-api/assoc_array.rst

	  for more information.

config CLOSURES
	bool

config HAS_IOMEM
	bool
	depends on !NO_IOMEM
	default y

config HAS_IOPORT
	bool

config HAS_IOPORT_MAP
	bool
	depends on HAS_IOMEM && !NO_IOPORT_MAP
	default y

source "kernel/dma/Kconfig"

config SGL_ALLOC
	bool
	default n

config IOMMU_HELPER
	bool

config CHECK_SIGNATURE
	bool

config CPUMASK_OFFSTACK
	bool "Force CPU masks off stack" if DEBUG_PER_CPU_MAPS
	help
	  Use dynamic allocation for cpumask_var_t, instead of putting
	  them on the stack.  This is a bit more expensive, but avoids
	  stack overflow.

config FORCE_NR_CPUS
	def_bool !SMP

config CPU_RMAP
	bool
	depends on SMP

config DQL
	bool

config GLOB
	bool
#	This actually supports modular compilation, but the module overhead
#	is ridiculous for the amount of code involved.	Until an out-of-tree
#	driver asks for it, we'll just link it directly it into the kernel
#	when required.  Since we're ignoring out-of-tree users,	there's also
#	no need bother prompting for a manual decision:
#	prompt "glob_match() function"
	help
	  This option provides a glob_match function for performing
	  simple text pattern matching.  It originated in the ATA code
	  to blacklist particular drive models, but other device drivers
	  may need similar functionality.

	  All drivers in the Linux kernel tree that require this function
	  should automatically select this option.  Say N unless you
	  are compiling an out-of tree driver which tells you that it
	  depends on this.

#
# Netlink attribute parsing support is select'ed if needed
#
config NLATTR
	bool

#
# Generic 64-bit atomic support is selected if needed
#
config GENERIC_ATOMIC64
       bool

config LRU_CACHE
	tristate

config CLZ_TAB
	bool

config IRQ_POLL
	bool "IRQ polling library"
	help
	  Helper library to poll interrupt mitigation using polling.

config MPILIB
	tristate
	select CLZ_TAB
	help
	  Multiprecision maths library from GnuPG.
	  It is used to implement RSA digital signature verification,
	  which is used by IMA/EVM digital signature extension.

config SIGNATURE
	tristate
	depends on KEYS
	select CRYPTO_LIB_SHA1
	select MPILIB
	help
	  Digital signature verification. Currently only RSA is supported.
	  Implementation is done using GnuPG MPI library

config DIMLIB
	tristate
	depends on NET
	help
	  Dynamic Interrupt Moderation library.
	  Implements an algorithm for dynamically changing CQ moderation values
	  according to run time performance.

#
# libfdt files, only selected if needed.
#
config LIBFDT
	bool

config OID_REGISTRY
	tristate
	help
	  Enable fast lookup object identifier registry.

config UCS2_STRING
	tristate

#
# generic vdso
#
source "lib/vdso/Kconfig"

source "lib/fonts/Kconfig"

config SG_SPLIT
	def_bool n
	help
	 Provides a helper to split scatterlists into chunks, each chunk being
	 a scatterlist. This should be selected by a driver or an API which
	 whishes to split a scatterlist amongst multiple DMA channels.

config SG_POOL
	def_bool n
	help
	 Provides a helper to allocate chained scatterlists. This should be
	 selected by a driver or an API which whishes to allocate chained
	 scatterlist.

#
# sg chaining option
#

config ARCH_NO_SG_CHAIN
	def_bool n

config ARCH_HAS_PMEM_API
	bool

config MEMREGION
	bool

config ARCH_HAS_CPU_CACHE_INVALIDATE_MEMREGION
	bool

config GENERIC_CPU_CACHE_MAINTENANCE
	bool

config ARCH_HAS_MEMREMAP_COMPAT_ALIGN
	bool

# use memcpy to implement user copies for nommu architectures
config UACCESS_MEMCPY
	bool

config ARCH_HAS_UACCESS_FLUSHCACHE
	bool

# arch has a concept of a recoverable synchronous exception due to a
# memory-read error like x86 machine-check or ARM data-abort, and
# implements copy_mc_to_{user,kernel} to abort and report
# 'bytes-transferred' if that exception fires when accessing the source
# buffer.
config ARCH_HAS_COPY_MC
	bool

# Temporary. Goes away when all archs are cleaned up
config ARCH_STACKWALK
       bool

config STACKDEPOT
	bool
	select STACKTRACE
	help
	  Stack depot: stack trace storage that avoids duplication

config STACKDEPOT_ALWAYS_INIT
	bool
	select STACKDEPOT
	help
	  Always initialize stack depot during early boot

config STACKDEPOT_MAX_FRAMES
	int "Maximum number of frames in trace saved in stack depot"
	range 1 256
	default 64
	depends on STACKDEPOT

config REF_TRACKER
	bool
	depends on STACKTRACE_SUPPORT
	select STACKDEPOT

config SBITMAP
	bool

config PARMAN
	tristate "parman" if COMPILE_TEST

config OBJAGG
	tristate "objagg" if COMPILE_TEST

config LWQ_TEST
	bool "Boot-time test for lwq queuing"
	help
	  Run boot-time test of light-weight queuing.

endmenu

config GENERIC_IOREMAP
	bool

config GENERIC_LIB_ASHLDI3
	bool

config GENERIC_LIB_ASHRDI3
	bool

config GENERIC_LIB_LSHRDI3
	bool

config GENERIC_LIB_MULDI3
	bool

config GENERIC_LIB_CMPDI2
	bool

config GENERIC_LIB_UCMPDI2
	bool

config GENERIC_LIB_DEVMEM_IS_ALLOWED
	bool

config PLDMFW
	bool
	select CRC32
	default n

config ASN1_ENCODER
       tristate

config FIRMWARE_TABLE
	bool

config UNION_FIND
	bool

config MIN_HEAP
	bool
```
